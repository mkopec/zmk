/*
 * Copyright (c) 2024 The ZMK Contributors
 *
 * SPDX-License-Identifier: MIT
 */

#include <dt-bindings/zmk/behaviors.h>

/ {
    behaviors {
#if ZMK_BEHAVIOR_OMIT(DISP_TOGGLE)
        /omit-if-no-ref/
#endif
        disp_tog: disp_toggle {
            compatible = "zmk,behavior-disp-toggle";
            #binding-cells = <0>;
            display-name = "Display Toggle";
        };
    };
};
